## CMakeLists.txt
```
# SPDX-License-Identifier: Apache-2.0

cmake_minimum_required(VERSION 3.20.0)

find_package(Zephyr REQUIRED HINTS $ENV{ZEPHYR_BASE})
project(minimal)

target_sources(app PRIVATE src/main.cpp)
```

## west.yml
```
manifest:
  remotes:
    - name: zephyrproject
      url-base: https://github.com/zephyrproject-rtos
  projects:
    - name: zephyr
      remote: zephyrproject
      revision: 8350fc2c63b10836bf3bf18a55f692fc6077e864
      path: zephyr
      import: True
  self:
    path: net_ieee802154_radio_build_fail
```

## prj.conf
```kconfig
CONFIG_CPP=y

CONFIG_IEEE802154=y
CONFIG_IEEE802154_RAW_MODE=y
CONFIG_NETWORKING=y
```

## src/main.c
```c
/*
 * Copyright (c) 2019 Nordic Semiconductor ASA
 *
 * SPDX-License-Identifier: Apache-2.0
 */

#include <zephyr/kernel.h>
#include <zephyr/net/ieee802154_radio.h>
#include <zephyr/device.h>
#include <zephyr/devicetree.h>

static const struct device* const radio_dev =
    DEVICE_DT_GET(DT_CHOSEN(zephyr_ieee802154));
/// Callback from the net stack zephyr to receive IEEE802.15.4 packets.
int net_recv_data(struct net_if* iface, struct net_pkt* pkt)
{
    return 0;
}

enum net_verdict ieee802154_handle_ack(struct net_if* iface,
                                             struct net_pkt* pkt)
{
    return NET_CONTINUE;
}

int main(void)
{
	return 0;
}
```

## src/main.cpp
```c
/*
 * Copyright (c) 2019 Nordic Semiconductor ASA
 *
 * SPDX-License-Identifier: Apache-2.0
 */

#include <zephyr/kernel.h>
#include <zephyr/net/ieee802154_radio.h>
#include <zephyr/device.h>
#include <zephyr/devicetree.h>

static const struct device* const radio_dev =
    DEVICE_DT_GET(DT_CHOSEN(zephyr_ieee802154));
/// Callback from the net stack zephyr to receive IEEE802.15.4 packets.
int net_recv_data(struct net_if* iface, struct net_pkt* pkt)
{
    return 0;
}

enum net_verdict ieee802154_radio_handle_ack(struct net_if* iface,
                                             struct net_pkt* pkt)
{
    return NET_CONTINUE;
}

int main(void)
{
	return 0;
}
```
